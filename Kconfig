## Kconfig
```kconfig
# For a description of syntax, see
# https://www.kernel.org/doc/Documentation/kbuild/kconfig-language.txt
#
mainmenu "Rotimatic Slave Configuration"

config BSP_DIR
    string
    option env = "ENV_BSP_DIR"
```
